#include <SoftwareSerial.h>

#include "JQ6500.h"

#include <Adafruit_NeoPixel.h>
#include "U8glib.h"
#include <EEPROM.h>

SoftwareSerial audioSerial(2,3);
JQ6500 AUDIO(&audioSerial);
Adafruit_NeoPixel strip = Adafruit_NeoPixel(1, 2, NEO_GRB + NEO_KHZ800);
long a;
long a_random;
long b;
long score;
long bingo;
long hold;
long miss;
long time1;
long time2;
long top;
unsigned long timer2lastTime = millis();
unsigned long timer1lastTime = millis();
boolean joy_stick(int pin, int mode) {
uint8_t joyStickA=-1,joyStickB=-2;
  while(joyStickA!=joyStickB){
    if (analogRead(pin) < 50) {
      joyStickA=0;
    }
    else if(analogRead(pin) < 374 && analogRead(pin) > 274){
      joyStickA=1;
    }
    else if(analogRead(pin) < 559 && analogRead(pin) > 459){
      joyStickA=2;
    }
    else if(analogRead(pin) < 751 && analogRead(pin) > 651){
      joyStickA=3;
    }
    else if(analogRead(pin) < 906 && analogRead(pin) > 806){
      joyStickA=4;
    }
    else if(analogRead(pin) > 973){
      joyStickA=5;
    }
    delay(20);
    if (analogRead(pin) < 50) {
      joyStickB=0;
    }
    else if(analogRead(pin) < 374 && analogRead(pin) > 274){
      joyStickB=1;
    }
    else if(analogRead(pin) < 559 && analogRead(pin) > 459){
      joyStickB=2;
    }
    else if(analogRead(pin) < 751 && analogRead(pin) > 651){
      joyStickB=3;
    }
    else if(analogRead(pin) < 906 && analogRead(pin) > 806){
      joyStickB=4;
    }
    else if(analogRead(pin) > 973){
      joyStickB=5;
    }
  }
  if(mode==joyStickB){
    return true;
  }
  else{
    return false;
  }
}

#define BuzzerPin8 8
int tone_list[] = {262, 294, 330, 349, 392, 440, 494, 523, 587, 659, 698, 784, 880, 988, 1046, 1175, 1318, 1397, 1568, 1760, 1967};
int music_1[] = {12, 10, 12, 10, 12, 10, 9, 10, 12, 12, 12, 10, 13, 12, 10, 12, 10, 9, 8, 9, 10, 12, 10, 9, 8, 9, 10, 0};
float rhythm_1[] = {1, 0.5, 1, 0.5, 0.5, 0.5, 0.5, 0.5, 2, 0.5, 1, 0.5, 1, 1, 0.5, 0.5, 0.5, 0.5, 1, 1, 1, 1, 0.5, 0.5, 0.5, 0.5, 2};
int music_2[] = {8, 9, 10, 8, 8, 9, 10, 8, 10, 11, 12, 10, 11, 12, 0};
float rhythm_2[] = {1, 1, 1, 1, 1, 1, 1, 1, 1, 1, 2, 1, 1, 2};
int music_3[] = {5, 8, 8, 10, 13, 10, 12, 12, 13, 12, 10, 11, 10, 9, 6, 9, 9, 11, 14, 14, 13, 12, 11, 11, 10, 6, 7, 8, 9, 0};
float rhythm_3[] = {0.5, 0.25, 0.5, 0.25, 0.5, 0.25, 1, 0.5, 0.25, 0.5, 0.25, 0.5, 0.25, 1, 0.5, 0.25, 0.5, 0.25, 0.5, 0.25, 0.5, 0.25, 1, 0.5, 0.25, 0.5, 1, 0.5, 3};
int music_4[] = {5,5,6,5,8,7,5,5,6,5,9,8,5,5,12,10,8,7,6,11,11,10,8,9,8,0};
float rhythm_4[] = {0.5,0.5,1,1,1,2,0.5,0.5,1,1,1,2,0.5,0.5,1,1,1,1,1,0.5,0.5,1,1,1,3};
int music_5[] = {12, 13, 12, 13, 12, 13, 12, 12, 15, 14, 13, 12, 13, 12, 12, 12, 10, 10, 12, 12, 10, 9, 11, 10, 9, 8, 9, 8, 0};
float rhythm_5[] = {0.5, 0.5, 0.5, 0.5, 0.5, 0.5, 1, 0.5, 0.5, 0.5, 0.5, 0.5, 0.5, 1, 0.5, 0.5, 0.5, 0.5, 0.5, 0.5, 1, 0.5, 0.5, 0.5, 0.5, 0.5, 0.5, 1};
int music_6[] = {8, 8, 10, 8, 8, 10, 22, 13, 13, 13, 12, 13, 12, 8, 10, 22, 15, 13, 13, 12, 13, 12, 8, 9, 22, 14, 14, 12, 10, 12, 0};
float rhythm_6[] = {1, 1, 2, 0.5, 1, 1, 1, 1, 1, 0.5, 0.5, 1, 0.5, 1, 1, 1, 0.5, 0.5, 0.5, 0.5, 2, 0.5, 1, 1, 1, 1, 0.5, 0.5, 1, 4};
int music_7[] = {6, 8, 9, 10, 12, 10, 8, 9, 6, 22, 8, 9, 10,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 12, 0};
float rhythm_7[] = {0.5, 0.5, 0.5, 1, 0.5, 0.5, 0.5, 1, 2, 0.5, 0.5, 0.5, 0.5,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 0.5, 3};
int music_8[] = {10, 8, 9, 6, 10, 9, 8, 9, 6, 10, 8, 9, 9, 12, 10, 7, 8, 8, 7, 6, 7, 8, 9, 5, 13, 12, 10, 10, 9, 8, 9, 10, 9, 10, 9, 12, 12, 12, 12, 12, 12, 0};
float rhythm_8[] = {1, 1, 1, 1, 0.5, 0.5, 0.5, 0.5, 2, 1, 1, 1, 1,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 0.5, 1};
int music_9[] = {10,12,15,13,12,10,12,13,15,12,15,17,16,15,16,15,13,15,12,0};
float rhythm_9[] = {0.5,0.5,0.5,0.5,2,0.5,0.5,0.5,0.5,2,1,0.5,1,1,0.5,0.5,0.5,0.5,2};
int music_10[] = {10,10,10,8,5,5,22,10,10,10,8,10,22,12,12,10,8,5,5,5,6,7,8,10,9,0};
float rhythm_10[] = {0.5,0.5,0.5,0.5,1,0.5,0.5,0.5,0.5,0.5,0.5,1,1,0.5,0.5,0.5,0.5,0.5,0.5,1,0.5,0.5,0.5,0.5,1};

U8GLIB_SSD1306_128X64 u8g(U8G_I2C_OPT_NONE);
#define setFont_L u8g.setFont(u8g_font_fur20)
#define setFont_S u8g.setFont(u8g_font_fixed_v0r)
#define setFont_M u8g.setFont(u8g_font_9x18)

static unsigned char hai[] U8G_PROGMEM = {
  0xFF,0xFF,0xFF,0xFF,0xFF,0xFF,0xFF,0xFF,0xFF,0xFF,0xFF,0xFF,0xFF,0xFF,0xFF,0xFF,
0xFF,0xFF,0xFF,0xFF,0xFF,0xFF,0xFF,0xFF,0xFF,0xFF,0xFF,0xFF,0xFF,0xFF,0xFF,0xFF,
0xFF,0xFF,0xFF,0xFF,0xFF,0xFF,0xFF,0xFF,0xFF,0xFF,0xFF,0xFF,0xFF,0xFF,0xFF,0xFF,
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0xFF,0xFF,0xFF,0xFF,0xFF,0xFF,0xFF,0xFF,0xFF,0xFF,0xFF,0xFF,0xFF,0xFF,0xFF,0xFF
};
static unsigned char xu[] U8G_PROGMEM = {
  0xFF,0xFF,0xFF,0xFF,0xFF,0xFF,0xFF,0xFF,0xFF,0xFF,0xFF,0xFF,0xFF,0xFF,0xFF,0xFF,
0xFF,0xFF,0xFF,0xFF,0xFF,0xFF,0xFF,0xFF,0xFF,0xFF,0xFF,0xFF,0xFF,0xFF,0xFF,0xFF,
0xFF,0xFF,0xFF,0xFF,0xFF,0xFF,0xFF,0xFF,0xFF,0xFF,0xFF,0xFF,0x07,0xF8,0xFF,0xFF,
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0xFF,0xFF,0xFF,0xFF,0xFF,0xFF,0xFF,0xFF,0xFF,0xFF,0xFF,0xFF,0xFF,0xFF,0xFF,0xFF
};
static unsigned char nu[] U8G_PROGMEM = {
  0xFF,0xFF,0xFF,0xFF,0xFF,0xFF,0xFF,0xFF,0xFF,0xFF,0xFF,0xFF,0xFF,0xFF,0xFF,0xFF,
0xFF,0xFF,0xFF,0xFF,0xFF,0xFF,0xFF,0xFF,0xFF,0xFF,0xC7,0xFF,0xFF,0xFF,0xFF,0xFF,
0xFF,0xFF,0x0F,0xFF,0xFF,0xFF,0xFF,0xFF,0xFF,0xFF,0x0F,0xFE,0xFF,0xFF,0xFF,0xFF,
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0xFF,0xFF,0xFF,0xFF,0xFF,0xFF,0xFF,0xFF,0xFF,0xFF,0xFF,0xFF,0xFF,0xFF,0xFF,0xFF
};
static unsigned char li[] U8G_PROGMEM = {
  0xFF,0xFF,0xFF,0xFF,0xFF,0xFF,0xFF,0xFF,0xFF,0xFF,0xFF,0xFF,0xFF,0xFF,0xFF,0xFF,
0xFF,0xFF,0xFF,0xFF,0xFF,0xFF,0xFF,0xFF,0xFF,0xFF,0xFF,0xFF,0xFF,0xFF,0xFF,0xFF,
0xFF,0xFF,0xFF,0xFF,0xFF,0xFF,0xFF,0xFF,0xFF,0xFF,0xFF,0x3F,0xFF,0xFF,0xFF,0xFF,
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0xFF,0xFF,0xFF,0xFF,0xFF,0xFF,0xFF,0xFF,0xFF,0xFF,0xFF,0xFF,0xFF,0xFF,0xFF,0xFF
};
static unsigned char youwin[] U8G_PROGMEM = {
  0xFF,0xFF,0xFF,0xFF,0xFF,0xFF,0xFF,0xFF,0xFF,0xFF,0xFF,0xFF,0xFF,0xFF,0xFF,0xFF,
0xFF,0xFF,0xFF,0xFF,0xFF,0xFF,0xFF,0xFF,0xFF,0xFF,0xFF,0xFF,0xFF,0xFF,0xFF,0xFF,
0xFF,0xFF,0xFF,0xFF,0xFF,0xFF,0xFF,0xFF,0xFF,0xFF,0xFF,0xFF,0xFF,0xFF,0xFF,0xFF,
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0xFF,0xFF,0xFF,0xFF,0xFF,0xFF,0xFF,0xFF,0xFF,0xFF,0xFF,0xFF,0xFF,0xFF,0xFF,0xFF
};

void stop() {
  u8g.undoRotation();
  u8g.firstPage();
  do {
    setFont_M;
    u8g.setPrintPos(0, 30);
    u8g.print("Welcome to the");
    setFont_M;
    u8g.setPrintPos(0, 60);
    u8g.print("BINGO GAME");
  } while( u8g.nextPage() );
  while(!joy_stick(A2,0));
  score = 0;
  timer2lastTime = millis();
  timer1lastTime = millis();
}

void start() {
  if (bingo == 1 || miss == 1) {
    while((a == a_random)) {
      a_random = random(1, 7);

    }
    a = a_random;
    bingo = 0;
    miss = 0;
    timer1lastTime = millis();

  }
}

void display() {
  b = (map(analogRead(A0), 1023, 0, 0, 90));
  u8g.undoRotation();
  u8g.firstPage();
  do {
    setFont_M;
    u8g.setPrintPos(60, 20);
    u8g.print(a);
    setFont_M;
    u8g.setPrintPos((60 - b), 40);
    u8g.print("1 2 3 4 5 6");
    setFont_M;
    u8g.setPrintPos(20, 60);
    u8g.print("SCORE:");
    setFont_M;
    u8g.setPrintPos(80, 60);
    u8g.print(score);
    setFont_M;
    u8g.setPrintPos(100, 20);
    u8g.print(time1);
    setFont_M;
    u8g.setPrintPos(0, 20);
    u8g.print(time2);
    setFont_M;
    u8g.setPrintPos(20, 20);
    u8g.print("s");
    setFont_M;
    u8g.setPrintPos(110, 20);
    u8g.print("s");
    setFont_S;
    u8g.setPrintPos(88, 64);
    u8g.print("top");
    setFont_S;
    u8g.setPrintPos(112, 64);
    u8g.print(top);
  } while( u8g.nextPage() );
}

void win() {
  if (score == 15) {
    time2 = (millis() - timer2lastTime);
    time2 = time2 / 1000;
    top = EEPROM.read(0);
    if (time2 < top) {
      u8g.undoRotation();
      u8g.firstPage();
      do {
        setFont_L;
        u8g.drawXBMP( 0, 0, 128, 64, youwin);     
      } while( u8g.nextPage() );
      delay(2000);
      u8g.undoRotation();
      u8g.firstPage();
      do {
        setFont_M;
        u8g.setPrintPos(0, 30);
        u8g.print("you are best!");
        setFont_L;
        u8g.setPrintPos(30, 60);
        u8g.print(time2);
      } while( u8g.nextPage() );
      EEPROM.write(0, time2);
      for (int a = 0; music_6[a] != 0; a++) {
        if (music_6[a] != 22) {
          tone(BuzzerPin8, tone_list[music_6[a] - 1]);
        }
        else {
          noTone(BuzzerPin8);
        }
        delay(rhythm_6[a] * 300);
        noTone(BuzzerPin8);
        delay(30);
      }
      delay(1000);

    } else {
      u8g.undoRotation();
      u8g.firstPage();
      do {
        setFont_L;
        u8g.drawXBMP( 32, 0, 64, 64, hai);     
      } while( u8g.nextPage() );
      delay(1000);
      u8g.undoRotation();
      u8g.firstPage();
      do {
        setFont_L;
        u8g.drawXBMP( 32, 0, 64, 64, xu);     
      } while( u8g.nextPage() );
      delay(1000);
      u8g.undoRotation();
      u8g.firstPage();
      do {
        setFont_L;
        u8g.drawXBMP( 32, 0, 64, 64, nu);    
      } while( u8g.nextPage() );
      delay(1000);
       u8g.undoRotation();
       u8g.firstPage();
      do {    
        setFont_L;
        u8g.drawXBMP( 32, 0, 64, 64, li);    
      } while( u8g.nextPage() );
      delay(1000);
      u8g.undoRotation();
      u8g.firstPage();
      do {
        setFont_L;
        u8g.setPrintPos(30, 40);
        u8g.print(time2);
      } while( u8g.nextPage() );
      strip.setPixelColor(1-1, 51,204,0);
      strip.show();
      delay(1000);
      strip.setPixelColor(1-1, 0,0,0);
      strip.show();

    }
    while(!joy_stick(A2,0));
    score = 0;
    timer2lastTime = millis();

  }
}

void BINGO() {
  if ((b + 27) / 18 == a) {
    hold = analogRead(A0);
    delay(100);
    if (analogRead(A0) == hold) {
      bingo = 1;
      score = score + 1;
      tone(BuzzerPin8,2000);
      delay(20);
      noTone(BuzzerPin8);

    }

  }
}

void time_out() {
  if ((millis() - timer1lastTime) > 3000) {
    strip.setPixelColor(1-1, 255,0,0);
    strip.show();
    tone(BuzzerPin8,200);
    delay(20);
    strip.setPixelColor(1-1, 0,0,0);
    strip.show();
    noTone(BuzzerPin8);
    miss = 1;

  }
}

void game_over() {
  if ((millis() - timer2lastTime) > 60000) {
    u8g.undoRotation();
    u8g.firstPage();
    do {
      setFont_L;
      u8g.setPrintPos(0, 30);
      u8g.print("GAME");
      setFont_L;
      u8g.setPrintPos(40, 60);
      u8g.print("OVER");
      tone(BuzzerPin8,262);
      delay(2000);
      noTone(BuzzerPin8);
    } while( u8g.nextPage() );
    while(!joy_stick(A2,0));
    score = 0;
    timer2lastTime = millis();

  }
}

void setup()
{
  AUDIO.init(DEVICE_TF,MODE_RAM,20);
AUDIO.choose(1);
AUDIO.pause();

  strip.begin();
  strip.show();
  a = 0;
  a_random = 0;
  b = 0;
  score = 0;
  bingo = 1;
  hold = 0;
  miss = 0;
  time1 = 0;
  time2 = 0;
  top = 0;
  for (int a = 0; music_3[a] != 0; a++) {
    if (music_3[a] != 22) {
      tone(BuzzerPin8, tone_list[music_3[a] - 1]);
    }
    else {
      noTone(BuzzerPin8);
    }
    delay(rhythm_3[a] * 300);
    noTone(BuzzerPin8);
    delay(30);
  }
  delay(1000);
  u8g.undoRotation();
  u8g.firstPage();
  do {
    setFont_M;
    u8g.setPrintPos(0, 30);
    u8g.print("Welcome to the");
    setFont_M;
    u8g.setPrintPos(0, 60);
    u8g.print("BINGO GAME");
  } while( u8g.nextPage() );
  while(!joy_stick(A2,0));
  top = EEPROM.read(0);
  u8g.undoRotation();
  u8g.firstPage();
  do {
    setFont_L;
    u8g.setPrintPos(30, 30);
    u8g.print("top");
    setFont_M;
    u8g.setPrintPos(40, 60);
    u8g.print(top);
  } while( u8g.nextPage() );
  while(!joy_stick(A2,1));
  timer2lastTime = millis();
  AUDIO.play();
}

void loop()
{
  time2 = (millis() - timer2lastTime);
  time1 = (millis() - timer1lastTime);
  time2 = time2 / 1000;
  time1 = time1 / 1000;
  if (joy_stick(A2,3)) {
    stop();

  } else {
    start();
    display();
    BINGO();
    win();
    time_out();
    game_over();

  }
  if (joy_stick(A2,2)) {
    AUDIO.pause();
  } else if (joy_stick(A2,4)) {
    AUDIO.play();}

}
